## main/Kconfig.projbuild
```kconfig
menu "Doorbell App Configuration"
    config GPIO_BUTTON_NUM
        int "Doorbell Button GPIO"
        default 19
        help
            GPIO number for the doorbell button. Assumes weak pullup, pull low when button pressed.
            
    config GPIO_CONFIG_NUM
        int "DIP Switch 3 (Config) GPIO"
        default 18
        help
            GPIO number for DIP SWITCH 3, which indicates config mode. Must support weak pullup. LOW=ON
        
    config GPIO_RINGER_NUM
        int "Ringer GPIO"
        default 13
        help
            GPIO number for the ringer

    config GPIO_LED_WIFI_NUM
        int "status WIFI LED Pin"
        default 2
        help
            Pin to use to indicate connection to WiFi or other network infrastructure

    config GPIO_LED_READY_NUM
        int "status READY LED Red Pin"
        default 12
        help
            GPIO for READY - A button has a bell or a bell has a button

    config GPIO_LED_CONFIG_NUM
        int "status CONFIG LED Red Pin"
        default 14
        help
            GPIO for CONFIG - The system is in config mode
        
    config GPIO_LED_RX_NUM
        int "status RX Pin"
        default 26
        help
            GPIO for RX - Receiving a remote button, heartbeat or acknowledge packet

    config GPIO_LED_TX_NUM
        int "status TX Pin"
        default 27
        help
            GPIO for TX - Sending a remote button, heartbeat or acknowledge packet
                    
    config SETUP_AP_SSID
        string "Setup AP Name"
        default "ESP32 Doorbell"
        help
            SSID (network name) for the configuration mode access point.

    config SETUP_AP_PASS
        string "Seup AP Password"
        default ""
        help
            WiFi password (WPA or WPA2) for configuration mode access point. Empty is open
            
    config SETUP_AP_CHANNEL
        int "Setup AP channel"
        default 1
        help
            Channel for the setup access point

    config SETUP_AP_CONN
        int "Setup AP Max Connections"
        default 2
        help
            Maximum connections for setup access point
        
endmenu
```
